/* Variable definitions for ESP32ULP linker
 * This file is generated automatically by esp32ulp_mapgen.py utility.
 */

PROVIDE ( ulp_channel_0_measurements = 0x500000c8 );
PROVIDE ( ulp_channel_1_measurements = 0x500008c8 );
PROVIDE ( ulp_channel_2_measurements = 0x500010c8 );
PROVIDE ( ulp_entry = 0x50000000 );
PROVIDE ( ulp_sample_counter = 0x500000b8 );
PROVIDE ( ulp_tmp_ch_0 = 0x500000bc );
PROVIDE ( ulp_tmp_ch_1 = 0x500000c0 );
PROVIDE ( ulp_tmp_ch_2 = 0x500000c4 );
